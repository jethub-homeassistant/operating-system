## buildroot-external/Config.in
```kconfig
source "$BR2_EXTERNAL_JHOS_PATH/package/generic_raw_uart/Config.in"
source "$BR2_EXTERNAL_JHOS_PATH/package/qemu-guest-agent/Config.in"
source "$BR2_EXTERNAL_JHOS_PATH/package/rtl88x2bu/Config.in"
source "$BR2_EXTERNAL_JHOS_PATH/package/tempio/Config.in.host"
source "$BR2_EXTERNAL_JHOS_PATH/package/udisks2/Config.in"
source "$BR2_EXTERNAL_JHOS_PATH/package/amlogic-boot-fip-e/Config.in"
source "$BR2_EXTERNAL_JHOS_PATH/package/jethome-burn/Config.in"
source "$BR2_EXTERNAL_JHOS_PATH/package/rtl8822cs-new/Config.in"
```

## buildroot-external/package/jethome-burn/Config.in
```kconfig
config BR2_PACKAGE_JETHOME_BURN
	 bool "jethome-burn"
	 help
	   This package enables create of burn images

	   https://github.com/jethome-ru/jethome-tools


if BR2_PACKAGE_JETHOME_BURN

config BR2_PACKAGE_JETHOME_BURN_BOARD
	string "Board for burnable image"
	depends on BR2_PACKAGE_JETHOME_BURN
	help
	  Name of the board for which burn binaries should be used
endif
```
